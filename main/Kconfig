## main/Kconfig
```kconfig
menu "MP3 PIN Configuration"

    config MP3_SPI_HOST
        int "SPI HOST NUM"
        default 1

    config MP3_SPI_PIN_MOSI
        int "MOSI GPIO number"
        default 7

    config MP3_SPI_PIN_MISO
        int "MISO GPIO number"
        default 5

    config MP3_SPI_PIN_CLK
        int "CLK GPIO number"
        default 6

    config ILI9341_SPI_PIN_CS
        int "ili341 CS GPIO number"
        default 11
    
    config ILI9341_SPI_PIN_DC
        int "ili341 DC GPIO number"
        default 12

    config SDCARD_SPI_PIN_CS
        int "sdcard CS GPIO number"
        default 13

endmenu
```
